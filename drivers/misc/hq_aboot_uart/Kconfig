## drivers/misc/hq_aboot_uart/Kconfig
```kconfig
#
# file create by liunianliang for ZQL1626-1175,2017.12.11
#

config HQ_ABOOT_UART
	bool "Enable HQ ABOOT UART LOG"
        default y
	help
	  CONFIG_HQ_ABOOT_UART will create proc/aboot_uart to record uart log before kernel.

	  If unsure, say N.
```

## drivers/misc/huaqin/Kconfig
```kconfig
#
# for huaqin mis info
#

# Huaqin add for ZQL1830-235 by liunianliang at 2018/07/05 start
config HQ_SIM_TRAY_CHECK
	bool "check sim stry status"
        default y
	help
	  this will create a node to show sim tray status.

	  If unsure, say N.
# Huaqin add for ZQL1830-235 by liunianliang at 2018/07/05 end

# Huaqin add for ZQL1830-278 by diganyun at 2018/08/14 start
config HQ_HARDWARE_INFO
	bool "show hardware info"
        default y
	help
	  this will create proc/hardwareinfo to show some hardware information.

	  If unsure, say N.
# Huaqin add for ZQL1830-278 by diganyun at 2018/08/14 end
```
